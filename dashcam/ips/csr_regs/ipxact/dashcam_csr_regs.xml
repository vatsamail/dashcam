# dashcam_csr_regs: IP-XACT component
VLNV ::dashcam_csr_regs:

## Address spaces and blocks
csr_map.csr: base 0x10000000, range 0x1000, width 32

## Registers
Registers are 32-bit, read-only, no defined reset value unless marked. A register's access mark holds for its fields unless they carry their own. Offsets are from the block's base; lines under a group give offsets from that group; [hi:lo] are bit positions; {n}, {i} and the like mark numbered series; 'fields as' and 'values as' point back to an identical list; <NAME> marks a mode.

## csr_map.csr
Base 0x10000000
0x00 CTRL rw
0x04 CAM_STATUS
0x08 DMA_BASE rw
0x0C DMA_LEN rw
0x10 DMA_STATUS
0x14 IRQ_STATUS
0x18 IRQ_CLEAR wo
0x1C IOMUX_SEL rw
0x20 SD_STATUS
0x24 BUILD_INFO
