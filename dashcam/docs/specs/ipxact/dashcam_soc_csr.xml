# dashcam_soc_csr: IP-XACT component
VLNV ::dashcam_soc_csr:

## Address spaces and blocks
csr_map.csr: base 0x10000000, range 0x1000, width 32

## Registers
Registers are 32-bit, read-only, no defined reset value unless marked. A register's access mark holds for its fields unless they carry their own. Offsets are from the block's base; lines under a group give offsets from that group; [hi:lo] are bit positions; {n}, {i} and the like mark numbered series; 'fields as' and 'values as' point back to an identical list; <NAME> marks a mode.

## csr_map.csr
Base 0x10000000
0x00 CTRL rw — REQ-CAM-001 camera enable bit0 dma start bit1 sd start bit2 irq enable bit3
0x04 CAM_STATUS — REQ-CAM-002 frame count in bits[15:0]
0x08 DMA_BASE rw — REQ-DMA-001 destination base offset in SRAM
0x0C DMA_LEN rw — REQ-DMA-002 transfer length in bytes
0x10 DMA_STATUS — REQ-DMA-003 done bit0 bytes_written bits[31:16]
0x14 IRQ_STATUS — REQ-INT-001 dma done irq pending bit0
0x18 IRQ_CLEAR wo — REQ-INT-002 write 1 to clear dma irq
0x1C IOMUX_SEL rw — REQ-IOMUX-001 pinmux selection register
0x20 SD_STATUS — REQ-SD-001 sd write count bits[15:0]
0x24 BUILD_INFO — REQ-GEN-001 build fingerprint
